## next/6.18.33d2/kernel/defconfig
```kconfig
CONFIG_COMPILE_TEST=y
# CONFIG_WERROR is not set
CONFIG_ARCH_SUNXI=y
CONFIG_MODULES=y
# CONFIG_IOSCHED_BFQ is not set
CONFIG_NET=y
CONFIG_CFG80211=y
CONFIG_CFG80211_WEXT=y
CONFIG_NETDEVICES=y
CONFIG_SERIAL_DEV_BUS=y
CONFIG_HW_RANDOM=y
CONFIG_MMC=y
CONFIG_STAGING=y
# CONFIG_RTL8723BS is not set
CONFIG_WLAN_VENDOR_REALTEK=y
CONFIG_RTL8723DS=m
CONFIG_SUNXI_CCU=y
# CONFIG_SUN20I_PPU is not set
# CONFIG_SUN55I_PCK600 is not set
CONFIG_RESET_GPIO=y
CONFIG_RESET_TI_SYSCON=y
CONFIG_RESET_TI_TPS380X=y
CONFIG_EFIVAR_FS=y
CONFIG_INIT_STACK_ALL_ZERO=y
CONFIG_RANDSTRUCT_NONE=y
# CONFIG_CRYPTO_DEV_ALLWINNER is not set
```

## next/7.1.2/kernel/defconfig
```kconfig
# 6.18.33 Default Configuration for MangoPi MQ Quad
CONFIG_ARCH_SUNXI=y
CONFIG_MODULES=y
CONFIG_NET=y
CONFIG_CFG80211=y
CONFIG_CFG80211_WEXT=y
CONFIG_NETDEVICES=y
CONFIG_SERIAL_DEV_BUS=y
CONFIG_HW_RANDOM=y
CONFIG_MMC=y
CONFIG_STAGING=y
CONFIG_WLAN_VENDOR_REALTEK=y
CONFIG_RTL8723DS=m
CONFIG_SUNXI_CCU=y
CONFIG_INIT_STACK_ALL_ZERO=y
CONFIG_RANDSTRUCT_NONE=y

# 7.1.2 Tweaks
CONFIG_RESET_SIMPLE=y

# UART Serial Communication Support
CONFIG_SERIAL_8250=y
CONFIG_SERIAL_8250_CONSOLE=y
CONFIG_SERIAL_8250_16550A_VARIANTS=y
CONFIG_SERIAL_OF_PLATFORM=y
CONFIG_SERIAL_8250_SUNXI=y

# Core Allwinner Power and Bus Drivers / Regulators
CONFIG_SUNXI_RSB=y
CONFIG_MFD_SUN6I_PRCM=y
CONFIG_REGULATOR_AXP20X=y
CONFIG_REGULATOR_AXP20X_I2C=y
CONFIG_REGULATOR_AXP20X_RSB=y
CONFIG_REGULATOR=y
CONFIG_REGULATOR_FIXED_VOLTAGE=y
CONFIG_REGULATOR_AXP313=y

# Allwinner MMC (SD Card Slot) Driver
CONFIG_MMC=y
CONFIG_MMC_SUNXI=y

# PMIC Core and Bus support
CONFIG_AXP_CONSOLE=y
CONFIG_MFD_AXP20X=y
CONFIG_MFD_AXP20X_I2C=y
CONFIG_MFD_AXP20X_RSB=y

# Ext4 Filesystem Support
CONFIG_EXT4_FS=y
CONFIG_EXT4_USE_FOR_EXT2=y
CONFIG_FS_IOMAP=y
CONFIG_CRC16=y
```
